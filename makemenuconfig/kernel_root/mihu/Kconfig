## makemenuconfig/kernel_root/mihu/Kconfig
```kconfig
menu "mihu test make menuconfig for 20200229"
#	help
#	  makemenuconfig begin arch/arm/Kconfig
#	  all Kconfig base on root dir
#	  I set the mihumenu to the init/Kconfig
source "mihu/mihu1/Kconfig"
	
endmenu
```

## makemenuconfig/kernel_root/mihu/mihu1/Kconfig
```kconfig
#
# 20200229  mihu test make menuconfig  
# This is subMenu
#

config MIHU_TEST_BOOL
	bool "bool /mihu/mihu1/Kconfig"
	help
	  This is mihu test! BOOL .

config MIHU_TEST_TRISTATE
	tristate "tristate"
	help
	  This is mihu test TRI..
          makemenuconfig begin arch/arm/Kconfig
          all Kconfig base on root dir
          I set the mihumenu to the init/Kconfig

			  
```
